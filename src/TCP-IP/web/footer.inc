</div>
</div>
</div>
</div>
</div>
</main>
<footer class="footer">
<div class="container-fluid">
<div class="row text-muted">
<div class="col-6 text-left">
<p class="mb-0">
    <a href="index.html" class="text-muted">
        <strong>Departamento de Electrónica - SEDA</strong>
    </a>
    &copy;
</p>
</div>
<div class="col-6 text-right">
<ul class="list-inline">
    <li class="list-inline-item">
        <a class="text-muted" href="mailto:david.carrascal@uah.es?subject=Proyecto%20SEDA">Contacto</a>
    </li>
    <li class="list-inline-item">
        <a class="text-muted" href="#https://www.uah.es/es/estudios/estudios-oficiales/masteres-universitarios/Ingenieria-de-Telecomunicacion/">MUIT</a>
    </li>
    <li class="list-inline-item">
        <a class="text-muted" href="https://www.uah.es/es/">
            Universidad de Alcalá</a>
    </li>
</ul>
</div>
</div>
</div>
</footer>
</div>
</div>
<script src="http://cdn.jsdelivr.net/gh/davidcawork/Pi-Home/js/app.js" integrity="sha384-1wBRxfarP8pgykX6RwYHTVKkyX8edFAwd6CgAcEpnSMLF7ozCNUtlxMw32PCowks" crossorigin="anonymous"></script>
</body>
</body>
</html>
